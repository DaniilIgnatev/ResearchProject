/ {
	amba_pl: amba_pl {
		ranges;
		compatible = "simple-bus";
		#address-cells = <1>;
		#size-cells = <1>;
		SK9822_AXI4_30_0: SK9822_AXI4_30@43c00000 {
			compatible = "xlnx,SK9822-AXI4-30-1.0";
			xlnx,led-number = <30>;
			xlnx,leds-axi-data-width = <32>;
			xlnx,settings-axi-addr-width = <4>;
			xlnx,rgb-axi-data-width = <32>;
			xlnx,rable = <0>;
			xlnx,ip-name = "SK9822_AXI4_30";
			reg = <0x43c00000 0x10000 0x43c10000 0x10000 0x43c20000 0x10000>;
			clocks = <&clkc 15>, <&clkc 15>, <&clkc 15>, <&clkc 15>;
			xlnx,settings-axi-data-width = <32>;
			xlnx,edk-iptype = "PERIPHERAL";
			xlnx,leds-axi-addr-width = <7>;
			xlnx,max-brightness = <8>;
			status = "okay";
			clock-names = "CLK" , "leds_axi_aclk" , "rgb_axi_aclk" , "settings_axi_aclk";
			xlnx,rgb-axi-addr-width = <4>;
			xlnx,name = "SK9822_AXI4_30_0";
		};
		SK9822_AXI4_30_1: SK9822_AXI4_30@43c30000 {
			compatible = "xlnx,SK9822-AXI4-30-1.0";
			xlnx,led-number = <30>;
			xlnx,leds-axi-data-width = <32>;
			xlnx,settings-axi-addr-width = <4>;
			xlnx,rgb-axi-data-width = <32>;
			xlnx,rable = <0>;
			xlnx,ip-name = "SK9822_AXI4_30";
			reg = <0x43c30000 0x10000 0x43c40000 0x10000 0x43c50000 0x10000>;
			clocks = <&clkc 15>, <&clkc 15>, <&clkc 15>, <&clkc 15>;
			xlnx,settings-axi-data-width = <32>;
			xlnx,edk-iptype = "PERIPHERAL";
			xlnx,leds-axi-addr-width = <7>;
			xlnx,max-brightness = <8>;
			status = "okay";
			clock-names = "CLK" , "leds_axi_aclk" , "rgb_axi_aclk" , "settings_axi_aclk";
			xlnx,rgb-axi-addr-width = <4>;
			xlnx,name = "SK9822_AXI4_30_1";
		};
	};
};
